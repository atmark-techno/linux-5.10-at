// SPDX-License-Identifier: (GPL-2.0 OR MIT)
/*
 * Copyright (C) 2025 Atmark Techno, Inc. All Rights Reserved.
 */

/dts-v1/;
/plugin/;

#include <dt-bindings/gpio/gpio.h>

&{/} {
	leds {
		stdwn_ind {
			label = "STDWN_IND";
			gpios = <&rpmsg_gpioc 23 GPIO_ACTIVE_HIGH>;
			linux,default-trigger = "default-off";
		};
	};
};
