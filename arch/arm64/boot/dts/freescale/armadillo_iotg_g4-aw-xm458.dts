// SPDX-License-Identifier: (GPL-2.0 OR MIT)
/*
 * Copyright (C) 2022 Atmark Techno, Inc. All Rights Reserved.
 */

/dts-v1/;
/plugin/;

#include <dt-bindings/gpio/gpio.h>

#include "imx8mp-pinfunc.h"

// wlan itself is automatically probed from PCI and is
// configured in armadillo_iotg_g4.dts directly
&uart1 {
	// pinctrl and status already set in default console
	bluetooth {
		compatible = "hci-uart-h4,generic";
		max-speed = <3000000>;
		hci-uart-h4,required-netdev = "mlan0";
	};
};
