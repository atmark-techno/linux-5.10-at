// SPDX-License-Identifier: (GPL-2.0 OR MIT)
/*
 * Copyright (C) 2025 Atmark Techno, Inc. All Rights Reserved.
 */

/dts-v1/;
/plugin/;

#include "imx8ulp-pinfunc.h"

/* will be overridden by at-dtweb */
&{/} {};
