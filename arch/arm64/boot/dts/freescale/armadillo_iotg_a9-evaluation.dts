// SPDX-License-Identifier: (GPL-2.0 OR MIT)
/*
 * Copyright (C) 2024 Atmark Techno, Inc. All Rights Reserved.
 */

/dts-v1/;
/plugin/;

// for evaluation of i2c_rpbus_1.
&usb2422_usbhub {
	status = "broken";
};
