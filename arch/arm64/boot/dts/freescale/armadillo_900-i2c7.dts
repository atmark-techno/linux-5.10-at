// SPDX-License-Identifier: (GPL-2.0 OR MIT)
/*
 * Copyright (C) 2025 Atmark Techno, Inc. All Rights Reserved.
 */

/dts-v1/;
/plugin/;

#include "imx8ulp-pinfunc-m33.h"
#include <dt-bindings/gpio/gpio.h>
#include <dt-bindings/input/input.h>
#include <dt-bindings/leds/common.h>

#include "imx8ulp-pinfunc.h"

// i2c7 required for a9e sd installer
&lpi2c7 {
	#address-cells = <1>;
	#size-cells = <0>;
	clock-frequency = <384000>;
	pinctrl-names = "default";
	pinctrl-0 = <&pinctrl_lpi2c7>;
	status = "okay";
};

&iomuxc1 {
	/* pinctrl memo
	 * 0x7c00000 deglitch window
	 * 0x200000 digital filter clock select (0=PCTL*, 1=RTC 1kHz)
	 * 0x100000 digital filter
	 * 0x20000 output buffer enable
	 * 0x10000 input buffer enable
	 * 0x40 high drive strength
	 * 0x20 open drain
	 * 0x4 slew rate
	 * 0x2 pull-up enable
	 * 0x1 pull-up selection (0=pull down)
	 */

	/* con 10 i2c */
	pinctrl_lpi2c7: i2c7grp {
		fsl,pins = <
			MX8ULP_PAD_PTF4__LPI2C7_SCL	0x24
			MX8ULP_PAD_PTF5__LPI2C7_SDA	0x24
		>;
	};
};
