// SPDX-License-Identifier: (GPL-2.0 OR MIT)
/*
 * Copyright (C) 2021 Atmark Techno, Inc. All Rights Reserved.
 */

/dts-v1/;
/plugin/;

&i2c2 {
	#address-cells = <1>;
	#size-cells = <0>;

	thcv24xa_ox01f10@65 {
		compatible = "thcv24xa_ox01f10";
		reg = <0x65>;
	};
};
