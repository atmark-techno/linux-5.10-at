// SPDX-License-Identifier: (GPL-2.0 OR MIT)
/*
 * Copyright (C) 2022 Atmark Techno, Inc. All Rights Reserved.
 */

/dts-v1/;
/plugin/;

&reg_usb1_host_vbus {
	status = "broken";
};

&usb1_vbus {
	status = "broken";
};
