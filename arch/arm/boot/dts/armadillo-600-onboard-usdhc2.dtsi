// SPDX-License-Identifier: (GPL-2.0 OR MIT)
/*
 * Copyright (C) 2020 Atmark Techno, Inc. All Rights Reserved.
 */

&reg_onboard_sd2_vmmc {
	regulator-boot-on;
};

&usdhc2 {
	assigned-clocks = <&clks IMX6UL_CLK_USDHC2_SEL>, <&clks IMX6UL_CLK_USDHC2>;
	assigned-clock-parents = <&clks IMX6UL_CLK_PLL2_PFD2>;
	assigned-clock-rates = <0>, <198000000>;

	pinctrl-names = "default";
	pinctrl-0 = <&pinctrl_usdhc2>;
	vmmc-supply = <&reg_onboard_sd2_vmmc>;
	no-1-8-v;
	keep-power-in-suspend;
	wakeup-source;
	status = "okay";
};

&iomuxc {
	pinctrl_usdhc2: usdhc2grp {
		fsl,pins = <
			MX6UL_PAD_NAND_DATA00__USDHC2_DATA0 0x10059
			MX6UL_PAD_NAND_DATA01__USDHC2_DATA1 0x10059
			MX6UL_PAD_NAND_DATA02__USDHC2_DATA2 0x10059
			MX6UL_PAD_NAND_DATA03__USDHC2_DATA3 0x10059
			MX6UL_PAD_NAND_RE_B__USDHC2_CLK     0x10069
			MX6UL_PAD_NAND_WE_B__USDHC2_CMD     0x10059
		>;
	};
};
