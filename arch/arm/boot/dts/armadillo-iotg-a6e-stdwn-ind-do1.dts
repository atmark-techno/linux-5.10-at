// SPDX-License-Identifier: (GPL-2.0 OR MIT)
/*
 * Copyright (C) 2023 Atmark Techno, Inc. All Rights Reserved.
 */

/dts-v1/;
/plugin/;

#include <dt-bindings/gpio/gpio.h>

&{/} {
	gpio-leds {
		stdwn_ind {
			label = "STDWN_IND";
			gpios = <&pca9534 2 GPIO_ACTIVE_LOW>;
			linux,default-trigger = "default-off";
		};
	};
};
