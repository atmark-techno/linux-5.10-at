// SPDX-License-Identifier: (GPL-2.0 OR MIT)
/*
 * Copyright (C) 2023 Atmark Techno, Inc. All Rights Reserved.
 */

/dts-v1/;
/plugin/;

#include <dt-bindings/gpio/gpio.h>
#include <dt-bindings/input/input.h>

&{/} {
	gpio-keys {
		sw1 {
			// Revert SW1 to its behaviour on debian 4.14 kernel:
			// enter key released when button is pushed
			label = "SW1";
			gpios = <&gpio1 10 GPIO_ACTIVE_LOW>;
			linux,code = <KEY_ENTER>;
		};
	};
};
