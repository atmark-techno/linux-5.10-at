/dts-v1/;
/plugin/;
#include <dt-bindings/gpio/gpio.h>
&{/} {
	gpio-leds {
		stdwn_ind {
			label = "STDWN_IND";
			gpios = <&gpio1 1 GPIO_ACTIVE_HIGH>;
			linux,default-trigger = "default-off";
		};
	};
};
