## Documentation/devicetree/bindings/gpio/gpio-fxl6408.txt
```
FXL6408 I2C to GPIO expander bindings

Example:
/* Connect the GPIO expander to I2C1 */
&i2c0 {
	pinctrl-names = "default";
	pinctrl-0 = <&i2c0_gpio44>;

	gpio_expander: gpio@43 {
		gpio-controller;
		#gpio-cells = <2>;
		reg = <0x43>;
		compatible = "fcs,fxl6408";
	};
};
```

## Documentation/devicetree/bindings/iio/common.yaml
```yaml
# SPDX-License-Identifier: (GPL-2.0 OR BSD-2-Clause)
%YAML 1.2
---
$id: http://devicetree.org/schemas/iio/common.yaml#
$schema: http://devicetree.org/meta-schemas/core.yaml#

title: Common properties for iio sensors

maintainers:
  - Jonathan Cameron <jic23@kernel.org>
  - Guido Günther <agx@sigxcpu.org>

description: |
  This document defines device tree properties common to several iio
  sensors. It doesn't constitute a device tree binding specification by itself
  but is meant to be referenced by device tree bindings.

  When referenced from sensor tree bindings the properties defined in this
  document are defined as follows. The sensor tree bindings are responsible for
  defining whether each property is required or optional.

  Note: it is also possible to request an index for the iio device through the
  "aliases" device tree node. It is however only used as a hint so care should
  be taken to either set all devices, or set indices in a range that will not
  be used by devices without aliases.

properties:
  proximity-near-level:
    $ref: /schemas/types.yaml#/definitions/uint32
    description: |
      For proximity sensors whether an object can be considered near to the
      device depends on parameters like sensor position, covering glass and
      aperture. This value gives an indication to userspace for which
      sensor readings this is the case.

      Raw proximity values equal or above this level should be
      considered 'near' to the device (an object is near to the
      sensor).

additionalProperties: true

...
```

## drivers/cache/Kconfig
```kconfig
# SPDX-License-Identifier: GPL-2.0
menu "Cache Drivers"

config AX45MP_L2_CACHE
	bool "Andes Technology AX45MP L2 Cache controller"
	help
	  Support for the L2 cache controller on Andes Technology AX45MP platforms.

endmenu
```

## drivers/misc/linmux/Kconfig
```kconfig
if THALES_LTE_MULTIPLEX
menu "Cinterion Linmux Driver"

config LINMUX_INSTANCES
	int "Linmux instances"
	depends on X86
	default 1
	range 1 256
	help
	  This option defines the number of driver instances.

config LINMUX_TTY_MAJOR_DEVNUM
	int "Linmux TTY major devnum"
	default 301
	range 1 511
	help
	  The major device number of the linmux tty device.

	  For each additional instance of the linmux driver this
	  number is incremented by 1.  So if there are more than one
	  instance used there must be a corresponding range of free
	  device numbers.

config LINMUX_FS_DEVICE_NAME
	string "Linmux FS device name"
	default "linmuxcfg"
	help
	  The name of the linmux character device for configuration

config LINMUX_FS_MAJOR_DEVNUM
	int "Linmux FS major devnum"
	default 300
	range 1 511
	help
	  The major device number of the linmux chracter device.

config LINMUX_CLIENT_MODE
	bool "Linmux client mode"
	default n
	help
	  Use multiplex protocol in host or in client mode. This
	  provides not the possibility for building the driver as
	  client driver just by modifying this flag. It is only for
	  simpler reuse of some source files.

config LINMUX_TRACE_ENABLED
	bool "Linmux trace enabled"
	default y
	help
	  Enable or disable trace output.

config LINMUX_POWER_MGMT_ENABLED
	bool "Linmux power mgmt enabled"
	default n
	help
	  Enable or disable power management.
endmenu

endif
```

## drivers/mxc/gpu-viv/Kconfig
```kconfig
menu "MXC Vivante GPU support"

config MXC_GPU_VIV
	tristate "MXC Vivante GPU support"
	default y
	depends on DRM && OF && (ARM || ARM64 || COMPILE_TEST)
	select DRM_KMS_HELPER
	select DRM_KMS_CMA_HELPER

	help
         Say Y to get the GPU driver support.

endmenu
```
